## CMakeLists.txt
```
# SPDX-FileCopyrightText: Copyright 2025 Clever Design (Switzerland) GmbH
# SPDX-License-Identifier: Apache-2.0
cmake_minimum_required(VERSION 3.20.0)

list(APPEND EXTRA_ZEPHYR_MODULES ${CMAKE_CURRENT_SOURCE_DIR}/../../../
     ${CMAKE_CURRENT_SOURCE_DIR}/../../../../typlatform)

find_package(Zephyr REQUIRED HINTS $ENV{ZEPHYR_BASE})

project(hello_world)
target_link_libraries(app PRIVATE tynet)
# Application Files
add_subdirectory(src)
```

## prj.conf
```kconfig
CONFIG_TYNET=y
CONFIG_TY_LOG=y
CONFIG_TY_LOG_LEVEL_INFO=y

#*****************************************************************************/
#*                                Logging                                    */
#*****************************************************************************/
CONFIG_LOG=y
CONFIG_LOG_DEFAULT_LEVEL=3
```

## src/main.cpp
```c
// SPDX-FileCopyrightText: Copyright 2025 Clever Design (Switzerland) GmbH
// SPDX-License-Identifier: Apache-2.0

/**
 * @file
 * @brief
 *   TyNet simplest example: Hello World
 */

#include <ty/logging.h>
#include <ty/platform/toolchain.h>
#include <zephyr/kernel.h>

#include <etl/string.h>
#include <ty/instance.h>
#include <ty/logging.h>

#include "tynet/mqtt/mqtt.hpp"

static const char    *kLogModule    = "HelloWorld";
const etl::string<32> kMqttUrl      = "mqtt://localhost:1883";
const etl::string<32> kMqttClientId = "mqtt_client";

extern "C" int main(void)
{
    tyInstance *instance;
    tyLogInfo(kLogModule, "Starting TyNet example");
    instance  = tyInstanceInitSingle();
    auto mqtt = ty::Mqtt::create(*instance);
    if (mqtt.has_value())
    {
        ty::Mqtt::MqttConfiguration mqttConfig = {kMqttUrl, kMqttClientId};
        mqtt->get()->Init(mqttConfig);
    }

    while (true)
    {
        // next event in 1 second
        sleep(1);
    }
    tyInstanceFinalize(instance);
    return 0;
}
```
