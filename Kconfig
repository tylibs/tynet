## Kconfig
```kconfig
config TYNET
	bool "TyNet Library"
	select SETTINGS if ZEPHYR_PLATFORM
	help
		This option enables the TyNet Library

if TYNET
menu "TyNet configuration"
config TYNET_ETH_ENABLED
	bool "Enable Ethernet"
	default "y"
	help
		Selects whether Ethernet support is enabled.


config TYNET_LOG
	bool "Enable logging"
	default "y"
	select LOG_COLORS if ESP_PLATFORM
	select LOG_DBG_COLOR_BLUE if ZEPHYR_PLATFORM
	help
		Selects whether logging messages.

endmenu # TyNet configuration
endif # TYNET
```
